/* ES8388 codec node */

es8388: es8388@10 {
    compatible = "tom,es8388";
    reg = <0x10>;

    DVDD-supply = <&vcc_1v8_s0>;
    PVDD-supply = <&vcc_1v8_s0>;
    AVDD-supply = <&vcc_3v3_s0>;
    HPVDD-supply = <&vcc_3v3_s0>;
    
    clocks = <&mclkout_i2s0>;
    clock-names = "mclk";
    assigned-clocks = <&mclkout_i2s0>;
    assigned-clock-rates = <12288000>;
    pinctrl-names = "default";
    pinctrl-0 = <&i2s0_mclk>;
};

